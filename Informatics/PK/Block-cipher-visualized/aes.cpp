#include "mainwindow.h"

const quint8 lookup1[256u] = {
    0x63u, 0x7cu, 0x77u, 0x7bu, 0xf2u, 0x6bu, 0x6fu, 0xc5u, 0x30u, 0x01u, 0x67u, 0x2bu, 0xfeu, 0xd7u, 0xabu, 0x76u,
    0xcau, 0x82u, 0xc9u, 0x7du, 0xfau, 0x59u, 0x47u, 0xf0u, 0xadu, 0xd4u, 0xa2u, 0xafu, 0x9cu, 0xa4u, 0x72u, 0xc0u,
    0xb7u, 0xfdu, 0x93u, 0x26u, 0x36u, 0x3fu, 0xf7u, 0xccu, 0x34u, 0xa5u, 0xe5u, 0xf1u, 0x71u, 0xd8u, 0x31u, 0x15u,
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    0x8cu, 0xa1u, 0x89u, 0x0du, 0xbfu, 0xe6u, 0x42u, 0x68u, 0x41u, 0x99u, 0x2du, 0x0fu, 0xb0u, 0x54u, 0xbbu, 0x16u };

const quint8 lookup2[256u] = {
    0x52u, 0x09u, 0x6au, 0xd5u, 0x30u, 0x36u, 0xa5u, 0x38u, 0xbfu, 0x40u, 0xa3u, 0x9eu, 0x81u, 0xf3u, 0xd7u, 0xfbu,
    0x7cu, 0xe3u, 0x39u, 0x82u, 0x9bu, 0x2fu, 0xffu, 0x87u, 0x34u, 0x8eu, 0x43u, 0x44u, 0xc4u, 0xdeu, 0xe9u, 0xcbu,
    0x54u, 0x7bu, 0x94u, 0x32u, 0xa6u, 0xc2u, 0x23u, 0x3du, 0xeeu, 0x4cu, 0x95u, 0x0bu, 0x42u, 0xfau, 0xc3u, 0x4eu,
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    0x17u, 0x2bu, 0x04u, 0x7eu, 0xbau, 0x77u, 0xd6u, 0x26u, 0xe1u, 0x69u, 0x14u, 0x63u, 0x55u, 0x21u, 0x0cu, 0x7du };

const quint8 lookup3[11u] = {
    0x8du, 0x01u, 0x02u, 0x04u, 0x08u, 0x10u, 0x20u, 0x40u, 0x80u, 0x1bu, 0x36u };

quint8 rK[176u];
quint8 iRK[16u];

void kGen(const quint8* k)
{
    for (unsigned i = 0u; i != 4u; ++i)
    {
        rK[i << 2u]           = k[i << 2u];
        rK[(i << 2u) + 1u]    = k[(i << 2u) + 1u];
        rK[(i << 2u) + 2u]    = k[(i << 2u) + 2u];
        rK[(i << 2u) + 3u]    = k[(i << 2u) + 3u];
    }

    for (unsigned i = 4u; i != 44u; ++i)
    {
        quint8 t[4u];
        unsigned rKIndex = (i - 1u) << 2u;

        t[0u] = rK[rKIndex];
        t[1u] = rK[rKIndex + 1u];
        t[2u] = rK[rKIndex + 2u];
        t[3u] = rK[rKIndex + 3u];

        if (!(i % 4u))
        {
            quint8 shift = t[0u];
            t[0u] = lookup1[t[1u]];
            t[1u] = lookup1[t[2u]];
            t[2u] = lookup1[t[3u]];
            t[3u] = lookup1[shift];
            t[0u] = t[0u] ^ lookup3[i >> 2u];
        }

        unsigned rKI1 = i << 2u, rKI2 = (i - 4u) << 2u;
        rK[rKI1]      = rK[rKI2]        ^ t[0u];
        rK[rKI1 + 1u] = rK[rKI2 + 1u]   ^ t[1u];
        rK[rKI1 + 2u] = rK[rKI2 + 2u]   ^ t[2u];
        rK[rKI1 + 3u] = rK[rKI2 + 3u]   ^ t[3u];
    }
}

void addrK(quint8 r, result* res)
{
    for (quint8 i = 0u; i != 4u; ++i)
        for (quint8 j = 0u; j != 4u; ++j)
            (*res)[i][j] ^= rK[(r << 4u) + (i << 2u) + j];
}

void mB(result* res)
{
    for (qint8 i = 0u; i != 4u; ++i)
        for (qint8 j = 0u; j != 4u; ++j)
            (*res)[j][i] = lookup1[(*res)[j][i]];
}

void sR(result* res)
{
    quint8 t       = (*res)[0u][1u];
    (*res)[0u][1u] = (*res)[1u][1u];
    (*res)[1u][1u] = (*res)[2u][1u];
    (*res)[2u][1u] = (*res)[3u][1u];
    (*res)[3u][1u] = t;
    t              = (*res)[0u][2u];
    (*res)[0u][2u] = (*res)[2u][2u];
    (*res)[2u][2u] = t;
    t              = (*res)[1u][2u];
    (*res)[1u][2u] = (*res)[3u][2u];
    (*res)[3u][2u] = t;
    t              = (*res)[0u][3u];
    (*res)[0u][3u] = (*res)[3u][3u];
    (*res)[3u][3u] = (*res)[2u][3u];
    (*res)[2u][3u] = (*res)[1u][3u];
    (*res)[1u][3u] = t;
}

quint8 xPow(quint8 x)
{
    return ((x << 1u) ^ (((x >> 7u) & 1u) * 0x1bu)); //[& 1u] dla pewności, mimo że QT powinien zapewnić, że zmienna będzie 8bitowa
}

void mC(result* res)
{
    for (quint8 i = 0u; i != 4u; ++i)
    {
        quint8  t1  = (*res)[i][0u];
        quint8  t2  = (*res)[i][0u] ^ (*res)[i][1u] ^ (*res)[i][2u] ^   (*res)[i][3u];
        quint8  Tm  = (*res)[i][0u] ^ (*res)[i][1u];  Tm = xPow(Tm);    (*res)[i][0u] ^= Tm ^ t2;
                Tm  = (*res)[i][1u] ^ (*res)[i][2u];  Tm = xPow(Tm);    (*res)[i][1u] ^= Tm ^ t2;
                Tm  = (*res)[i][2u] ^ (*res)[i][3u];  Tm = xPow(Tm);    (*res)[i][2u] ^= Tm ^ t2;
                Tm  = (*res)[i][3u] ^ t1;             Tm = xPow(Tm);    (*res)[i][3u] ^= Tm ^ t2;
    }
}

void iMC(result* res)
{
    for (unsigned i = 0u; i != 4u; ++i)
    {
        quint8 a = (*res)[i][0u];
        quint8 b = (*res)[i][1u];
        quint8 c = (*res)[i][2u];
        quint8 d = (*res)[i][3u];

        #define bitMulti(x, y)                            \
          (((y      & 1u) * x) ^                          \
          ((y >> 1u & 1u) * xPow(x)) ^                    \
          ((y >> 2u & 1u) * xPow(xPow(x))) ^              \
          ((y >> 3u & 1u) * xPow(xPow(xPow(x)))) ^        \
          ((y >> 4u & 1u) * xPow(xPow(xPow(xPow(x))))))   \

        (*res)[i][0u] = bitMulti(a, 0x0eu) ^ bitMulti(b, 0x0bu) ^ bitMulti(c, 0x0du) ^ bitMulti(d, 0x09u);
        (*res)[i][1u] = bitMulti(a, 0x09u) ^ bitMulti(b, 0x0eu) ^ bitMulti(c, 0x0bu) ^ bitMulti(d, 0x0du);
        (*res)[i][2u] = bitMulti(a, 0x0du) ^ bitMulti(b, 0x09u) ^ bitMulti(c, 0x0eu) ^ bitMulti(d, 0x0bu);
        (*res)[i][3u] = bitMulti(a, 0x0bu) ^ bitMulti(b, 0x0du) ^ bitMulti(c, 0x09u) ^ bitMulti(d, 0x0eu);
    }
}

void imB(result* res)
{
    for (qint8 i = 0u; i != 4u; ++i)
        for (qint8 j = 0u; j != 4u; ++j)
            (*res)[j][i] = lookup2[(*res)[j][i]];
}

void isR(result* res)
{
    quint8 t       = (*res)[3u][1u];
    (*res)[3u][1u] = (*res)[2u][1u];
    (*res)[2u][1u] = (*res)[1u][1u];
    (*res)[1u][1u] = (*res)[0u][1u];
    (*res)[0u][1u] = t;
    t              = (*res)[0u][2u];
    (*res)[0u][2u] = (*res)[2u][2u];
    (*res)[2u][2u] = t;
    t              = (*res)[1u][2u];
    (*res)[1u][2u] = (*res)[3u][2u];
    (*res)[3u][2u] = t;
    t              = (*res)[0u][3u];
    (*res)[0u][3u] = (*res)[1u][3u];
    (*res)[1u][3u] = (*res)[2u][3u];
    (*res)[2u][3u] = (*res)[3u][3u];
    (*res)[3u][3u] = t;
}

void encryptStep(result *res, quint8 key[16u])
{
    kGen(key);
    addrK(0u, res);

    for (quint8 r = 1u;; ++r)
    {
        mB(res);
        sR(res);

        if (r == 10u)
            break;

        mC(res);
        addrK(r, res);
    }
    addrK(10u, res);
}

void encrypt(quint8 buf[16u], quint8 key[16u], blockMode mode, quint8 xorBuf[16u])
{
    result* res = reinterpret_cast<result*>(buf);

    switch(mode)
    {
    case CBC:
        for (unsigned i = 0u; i != 16u; ++i)
            buf[i] ^= xorBuf[i];
        break;
    case CFB:
        res = reinterpret_cast<result*>(xorBuf);
        break;
    case ECB:
    default:
        break;
    }

    encryptStep(res, key);

    switch(mode)
    {
    case CFB:
        for (unsigned i = 0u; i != 16u; ++i)
            buf[i] ^= xorBuf[i];
    case CBC:
        for (unsigned i = 0u; i != 16u; ++i)
            xorBuf[i] = buf[i];
        break;
    case ECB:
    default:
        break;
    }
}

void decryptStep(result *res, quint8 key[16u])
{
    kGen(key);
    addrK(10u, res);

    for (quint8 r = 9u;; --r)
    {
        isR(res);
        imB(res);
        addrK(r, res);
        if (r == 0u)
            break;

        iMC(res);
    }
}

void decrypt(quint8 buf[16u], quint8 key[16u], blockMode mode, quint8 xorBuf[16u])
{
    result* res = reinterpret_cast<result*>(buf);
    quint8 bufCopy[16u];
    memcpy(bufCopy, buf, 16u);

    switch(mode)
    {
    case CFB:
        res = reinterpret_cast<result*>(xorBuf);
        encryptStep(res, key);
        break;
    case ECB:
    case CBC:
    default:
        decryptStep(res, key);
        break;
    }


    switch(mode)
    {
    case CBC:
    case CFB:
        for (unsigned i = 0u; i != 16u; ++i)
        {
            buf[i] ^= xorBuf[i];
            xorBuf[i] = bufCopy[i];
        }
        break;
    case ECB:
    default:
        break;
    }

}
